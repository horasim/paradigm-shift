## boards/shields/paradigm-shift/Kconfig.defconfig
```kconfig
# Copyright (c) 2021 The ZMK Contributors
# SPDX-License-Identifier: MIT

if SHIELD_PARADIGM_SHIFT_LEFT

config ZMK_KEYBOARD_NAME
    default "paradigm_shift"

config ZMK_SPLIT_ROLE_CENTRAL
    default y

endif

if SHIELD_PARADIGM_SHIFT_LEFT || SHIELD_PARADIGM_SHIFT_RIGHT

config ZMK_SPLIT
    default y

endif
```
